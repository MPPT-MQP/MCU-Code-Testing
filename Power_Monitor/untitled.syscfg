/**
 * These arguments were used when this file was generated. They will be automatically applied on subsequent loads
 * via the GUI or CLI. Run CLI with '--help' for additional information on how to override these arguments.
 * @cliArgs --device "Other" --part "Other" --package "Other" --product "ascstudio@1.0.15"
 * @v2CliArgs --device "Other" --package "Other" --product "ascstudio@1.0.15"
 * @versions {"tool":"1.22.0+3893"}
 */

/**
 * Import the modules used in this configuration.
 */
const INA740  = scripting.addModule("/ti/sensors/currentsensor/INA740", {}, false);
const INA7401 = INA740.addInstance();

/**
 * Write custom configuration values to the imported modules.
 */
INA7401.$name = "INA740_0";
